MEMORY
{
    PM_PLUGIN_TEXT (rx) : ORIGIN = @PM_PLUGIN_TEXT_ORIGIN@, LENGTH = @PM_PLUGIN_TEXT_LENGTH@
    PM_PLUGIN_RODATA (r) : ORIGIN = @PM_PLUGIN_RODATA_ORIGIN@, LENGTH = @PM_PLUGIN_RODATA_LENGTH@
    PM_PLUGIN_DATA (rw) : ORIGIN = @PM_PLUGIN_DATA_ORIGIN@, LENGTH = @PM_PLUGIN_DATA_LENGTH@
}

INCLUDE "@PLUGIN_MANAGER_SOURCE_DIR@/cmake/plugin_manager_plugin.ld"

ENTRY(pm_plugin_get_descriptor)
